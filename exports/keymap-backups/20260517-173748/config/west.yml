## exports/keymap-backups/20260517-173748/config/west.yml
```yaml
manifest:
  remotes:
    - name: zmkfirmware
      url-base: https://github.com/zmkfirmware
    - name: dev-vinicius-andrade
      url-base: https://github.com/dev-vinicius-andrade
    # Additional modules containing boards/shields/custom code can be listed here as well
    # See https://docs.zephyrproject.org/3.2.0/develop/west/manifest.html#projects
  projects:
    - name: zmk
      remote: dev-vinicius-andrade
      revision: feature/multiple-dongles
      import: app/west.yml
  self:
    path: config
```
